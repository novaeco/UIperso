## components/sdspi_ch422g/Kconfig.projbuild
```kconfig
menu "CH422G-controlled SDSPI"

config SDSPI_DIAG_EXIO_SCAN
    bool "Enable EXIO scan diagnostic for SD CS"
    default n
    help
        When enabled, a diagnostic routine can temporarily probe EXIO0..EXIO7
        as potential SD chip-select lines to detect miswired CS routing. This
        is intended for bring-up only; keep disabled in production builds.

endmenu
```

## components/storage/Kconfig.projbuild
```kconfig
menu "Storage"

config ENABLE_SDCARD
    bool "Enable SD card support"
    default n
    help
        Disable to skip SD card initialization and mount.

config SDCARD_SPI_MOSI_GPIO
    int "SD card SPI MOSI GPIO"
    default 11
    help
        GPIO used for SD card MOSI when the IO extension CS path is unavailable.

config SDCARD_SPI_MISO_GPIO
    int "SD card SPI MISO GPIO"
    default 13
    help
        GPIO used for SD card MISO when the IO extension CS path is unavailable.

config SDCARD_SPI_SCK_GPIO
    int "SD card SPI SCK GPIO"
    default 12
    help
        GPIO used for SD card SCK when the IO extension CS path is unavailable.

config SDCARD_SPI_CS_GPIO
    int "SD card SPI CS GPIO (fallback)"
    default 10
    help
        Chip-select GPIO for the SD card when CH422G is not available. On the
        Waveshare ESP32-S3-Touch-LCD-7B, the schematic routes SD_CS through
        EXIO4 on the CH422G IO extender; this option is only used as a direct
        GPIO fallback.

endmenu
```

## main/Kconfig.projbuild
```kconfig
menu "UIperso options"

config ENABLE_DISPLAY
    bool "Enable RGB display bring-up"
    default y
    help
        Control initialization of the RGB display pipeline. Disable only for
        headless diagnostics; the UI manager expects a display in normal
        builds.

config ENABLE_TOUCH
    bool "Enable GT911 touch controller"
    default y
    help
        Allow GT911 touch controller initialization and LVGL input device
        registration. Disable to skip touch bring-up at boot.

config ENABLE_SDCARD
    bool "Enable microSD (external storage)"
    default n
    help
        Enable initialization and mounting of the external microSD card.
        Disable to skip any SD card probing and boot without external
        storage access.

config I2C_SCAN_AT_BOOT
    bool "Scan shared I2C bus at boot"
    default n
    help
        If enabled, probe all addresses on the shared I2C bus during boot
        for diagnostics.

config UI_SMOKE_MODE
    bool "Enable LVGL smoke-test overlay"
    default y
    help
        When enabled, create a simple LVGL overlay with a centered label
        ("LVGL OK") to validate the render pipeline independently of the
        full application UI. Intended for bring-up and diagnostics; can be
        disabled in production builds.

config DIAG_RGB_TESTPATTERN
    bool "Draw RGB hardware test pattern (panel-only)"
    default n
    help
        When enabled, draw a simple vertical color bar test pattern directly
        after the RGB panel is initialized. This bypasses LVGL to validate the
        panel wiring and timing. Leave disabled for normal UI bring-up.

config LVGL_TICK_PERIOD_US
    int "LVGL esp_timer tick period (µs)"
    range 500 5000
    default 1000
    help
        Period (in microseconds) of the esp_timer that feeds lv_tick_inc().
        Keep within the 0.5–5 ms range to balance responsiveness and CPU use.

config LVGL_HANDLER_PERIOD_MS
    int "LVGL handler task period (ms)"
    range 2 20
    default 5
    help
        Delay between consecutive lv_timer_handler() calls in the dedicated
        LVGL task. 5 ms matches LVGL recommendations for smooth rendering
        without overloading the CPU.

config ENABLE_CAN
    bool "Enable CAN (TWAI) controller"
    default n
    help
        Enable initialization of the onboard CAN (TWAI) controller. When
        disabled, the firmware skips any CAN pin configuration or driver
        bring-up.

if ENABLE_CAN

choice CAN_BITRATE
    prompt "CAN bitrate"
    default CAN_BITRATE_500K

config CAN_BITRATE_125K
    bool "125 kbit/s"

config CAN_BITRATE_250K
    bool "250 kbit/s"

config CAN_BITRATE_500K
    bool "500 kbit/s"

config CAN_BITRATE_1M
    bool "1 Mbit/s"

endchoice

config CAN_LISTEN_ONLY
    bool "Enable CAN listen-only debug mode"
    default n
    help
        Start the TWAI controller in listen-only mode for passive bus
        monitoring during debugging.

endif

config ENABLE_RS485
    bool "Enable RS485 (UART1)"
    default n
    help
        Enable initialization of the RS485 half-duplex UART. When disabled
        the driver is skipped entirely and no GPIOs are touched.

config ENABLE_POWER
    bool "Enable CS8501 power telemetry"
    default y
    help
        Enable CS8501 initialization and telemetry reads. Disable if the
        CS8501 is not populated on the board revision.

endmenu
```

## sdkconfig.defaults
```kconfig
# PSRAM / SPIRAM configuration for Waveshare ESP32-S3-Touch-LCD-7B
# Module: ESP32-S3-WROOM-1-N16R8 (16MB Flash + 8MB OPI PSRAM, Octal mode)
# DO NOT change these without verifying hardware:
#  - Octal PSRAM mode
#  - 8MB ESPPSRAM64
#  - 80 MHz PSRAM clock
CONFIG_ESPTOOLPY_FLASHSIZE_16MB=y
CONFIG_PARTITION_TABLE_CUSTOM=y
CONFIG_PARTITION_TABLE_FILENAME="partitions.csv"
CONFIG_PARTITION_TABLE_MD5=y
CONFIG_IDF_TARGET="esp32s3"
CONFIG_ESP32S3_SPIRAM_SUPPORT=y
CONFIG_SPIRAM_BOOT_INIT=y
CONFIG_SPIRAM_MODE_OCT=y
# CONFIG_SPIRAM_MODE_QUAD is not set
CONFIG_SPIRAM_TYPE_ESPPSRAM64=y
# CONFIG_SPIRAM_TYPE_AUTO is not set
CONFIG_SPIRAM_SPEED_80M=y
# CONFIG_SPIRAM_SPEED_120M is not set
CONFIG_SPIRAM_USE_MALLOC=y
CONFIG_SPIRAM_MALLOC_ALWAYSINTERNAL=32768
CONFIG_SPIRAM_TRY_ALLOCATE_WIFI_LWIP=y
CONFIG_ESP_SYSTEM_MEMPROT_FEATURE=y
CONFIG_FREERTOS_HZ=1000
CONFIG_FREERTOS_ASSERT_FAIL_ABORT=y
CONFIG_ESP_CONSOLE_UART_BAUDRATE=115200
CONFIG_I2C_SUPPRESS_DEPRECATE_WARN=y
# LVGL built-in fonts required by the UI
CONFIG_LV_FONT_MONTSERRAT_14=y
CONFIG_LV_FONT_MONTSERRAT_16=y
CONFIG_LV_FONT_MONTSERRAT_20=y
CONFIG_LV_FONT_MONTSERRAT_24=y

# Increase main task resources to accommodate LVGL layout and log processing
CONFIG_ESP_MAIN_TASK_STACK_SIZE=16384
CONFIG_ESP_TASK_WDT_TIMEOUT_S=30
CONFIG_ESP_TASK_WDT_CHECK_IDLE_TASK_CPU0=n

# Prevent regression to the double-tick panic seen when CONFIG_LV_TICK_CUSTOM was enabled
CONFIG_LV_TICK_CUSTOM=n

# Ensure panic handler prints a backtrace before rebooting (avoid silent rst:0xc loops)
CONFIG_ESP_SYSTEM_PANIC_PRINT_REBOOT=y

# SDSPI fallback pins (used only if the CH422G IO extension is unavailable)
CONFIG_SDCARD_SPI_MOSI_GPIO=11
CONFIG_SDCARD_SPI_MISO_GPIO=13
CONFIG_SDCARD_SPI_SCK_GPIO=12
CONFIG_SDCARD_SPI_CS_GPIO=10

# Storage options
# Disable SD card by default for UI-only testing; set to y to re-enable storage
CONFIG_ENABLE_SDCARD=n
```
